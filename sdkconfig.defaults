## sdkconfig.defaults
```kconfig
# UART console
CONFIG_ESP_CONSOLE_UART_DEFAULT=y
CONFIG_ESP_CONSOLE_UART_NUM=0
CONFIG_ESP_CONSOLE_UART_BAUDRATE=115200

# I2C
CONFIG_I2C_ENABLE_DEBUG_LOG=n

# FreeRTOS
CONFIG_FREERTOS_HZ=1000
```
